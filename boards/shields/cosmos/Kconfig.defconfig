## boards/shields/cosmos/Kconfig.defconfig
```kconfig
if SHIELD_PIANTOR_DONGLE || SHIELD_PIANTOR_LEFT || SHIELD_PIANTOR_RIGHT
config ZMK_SPLIT
	default y
config ZMK_POINTING
    default y
endif

if SHIELD_PIANTOR_DONGLE
config ZMK_KEYBOARD_NAME
	default "Kai Cosmos"
config ZMK_SPLIT_ROLE_CENTRAL
	default y
endif

if SHIELD_PIANTOR_RIGHT
config SPI
    default y

endif
```
